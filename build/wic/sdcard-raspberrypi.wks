## build/wic/sdcard-raspberrypi.wks
```
# SPDX-License-Identifier: GPL-3.0-only
# Copyright (C) 2026 Secluso, Inc.
# Additional terms apply; see the NOTICE file in the repository root.

# Took base before modification from https://github.com/agherzan/meta-raspberrypi/blob/master/wic/sdimage-raspberrypi.wks
# Specifically: what's modified here is the inclusion of --uuid and --fsuuid parameters to pin the partition and filesystem UUID. This is to tighten reproducible builds.
# https://docs.yoctoproject.org/ref-manual/kickstart.html specifies wks options and explanations as such

# short-description: Create Raspberry Pi SD card image
# long-description: Creates a partitioned SD card image for use with
# Raspberry Pi. Boot files are located in the first vfat partition.

# that short hex value comes from the disk signature / disk identifier in the MBR
# fsuuid is a 32-bit hexadecimal (0xABCD1234) on /boot due to it being a vfat file system

# blkid with current configuration:
# /dev/loop6p1: SEC_TYPE="msdos" LABEL_FATBOOT="boot" LABEL="boot" UUID="ABCD-1234" BLOCK_SIZE="512" TYPE="vfat" PARTUUID="1ba0fb6d-01"
# /dev/loop6p2: LABEL="root" UUID="59aa4d0b-2b86-4550-b711-8ee512955940" BLOCK_SIZE="1024" TYPE="ext4" PARTUUID="1ba0fb6d-02"

part /boot --source bootimg-partition --uuid 19c8b09a-9511-47c5-bcfd-c7ed89dce60e --fsuuid 0xABCD1234 --ondisk mmcblk0 --fstype=vfat --label boot --active --align 4096 --size 100
part / --source rootfs --uuid a3bbee25-b921-4c33-ad76-64b56abb3900 --fsuuid 59aa4d0b-2b86-4550-b711-8ee512955940 --ondisk mmcblk0 --fstype=ext4 --label root --align 4096
```

## meta-secluso-os/conf/distro/include/gcsections.inc
```bitbake
# SPDX-License-Identifier: MIT
#
# Copied verbatim from meta-yocto at the yocto-5.3.3 (whinlatter) tag, commit 9b98ec5e6cfb6c9dc74d3c2e6304eeb274f7c487:
# https://git.yoctoproject.org/meta-yocto/tree/meta-poky/conf/distro/include/gcsections.inc?h=yocto-5.3.3
#
# The original file in meta-poky is MIT-licensed under the OpenEmbedded license (meta-yocto's COPYING.MIT).
# Thus, it is kept under that license here.

CFLAGS_SECTION_REMOVAL = "-ffunction-sections -fdata-sections"
LDFLAGS_SECTION_REMOVAL = "-Wl,--gc-sections"

# packages with build problems using sections
CFLAGS_SECTION_REMOVAL:pn-glibc = ""
LDFLAGS_SECTION_REMOVAL:pn-glibc = ""
CFLAGS_SECTION_REMOVAL:pn-cairo = ""
LDFLAGS_SECTION_REMOVAL:pn-cairo = ""
CFLAGS_SECTION_REMOVAL:pn-perl = ""
LDFLAGS_SECTION_REMOVAL:pn-perl = ""
CFLAGS_SECTION_REMOVAL:pn-grub-efi = ""
LDFLAGS_SECTION_REMOVAL:pn-grub-efi = ""
CFLAGS_SECTION_REMOVAL:pn-grub = ""
LDFLAGS_SECTION_REMOVAL:pn-grub = ""

# SDK packages with build problems using sections
CFLAGS_SECTION_REMOVAL:pn-nativesdk-glibc = ""
LDFLAGS_SECTION_REMOVAL:pn-nativesdk-glibc = ""
CFLAGS_SECTION_REMOVAL:pn-nativesdk-cairo = ""
LDFLAGS_SECTION_REMOVAL:pn-nativesdk-cairo = ""
CFLAGS_SECTION_REMOVAL:pn-nativesdk-mingw-w64-runtime = ""
LDFLAGS_SECTION_REMOVAL:pn-nativesdk-mingw-w64-runtime = ""
CFLAGS_SECTION_REMOVAL:pn-nativesdk-perl = ""
LDFLAGS_SECTION_REMOVAL:pn-nativesdk-perl = ""
CFLAGS_SECTION_REMOVAL:pn-nativesdk-mingw-w64-winpthreads = ""
LDFLAGS_SECTION_REMOVAL:pn-nativesdk-mingw-w64-winpthreads = ""

# set default for target
CFLAGS:append:class-target = " ${CFLAGS_SECTION_REMOVAL}"
CXXFLAGS:append:class-target = " ${CFLAGS_SECTION_REMOVAL}"
LDFLAGS:append:class-target = " ${LDFLAGS_SECTION_REMOVAL}"

# set default for nativesdk
CFLAGS:append:class-nativesdk = " ${CFLAGS_SECTION_REMOVAL}"
CXXFLAGS:append:class-nativesdk = " ${CFLAGS_SECTION_REMOVAL}"
LDFLAGS:append:class-nativesdk = " ${LDFLAGS_SECTION_REMOVAL}"
```

## meta-secluso-os/conf/distro/secluso.conf
```bitbake
# SPDX-License-Identifier: GPL-3.0-only
# Copyright (C) 2026 Secluso, Inc.
# Additional terms apply; see the NOTICE file in the repository root.

# Secluso OS distribution configuration.
#
# Modeled on poky.conf from meta-yocto at the yocto-5.3.3 (whinlatter) tag, commit 9b98ec5e6cfb6c9dc74d3c2e6304eeb274f7c487:
# https://git.yoctoproject.org/meta-yocto/tree/meta-poky/conf/distro/poky.conf?h=yocto-5.3.3
#
# Differences from poky.conf are documented inline.
#
# TODO: A lot more can be stripped out (e.g. Bluetooth)

DISTRO = "secluso"
DISTRO_NAME = "Secluso OS"
DISTRO_VERSION = "1.0.2"

# We are based on the Yocto whinlatter (5.3.3) release.
DISTRO_CODENAME = "whinlatter"

MAINTAINER = "Secluso <secluso@proton.me>"

# TARGET_VENDOR flows into the cross-toolchain triplet (aarch64-secluso-linux)
# and ends up embedded in every binary's interpreter path / rpaths. This is the
# main mechanism by which shipped artifacts stop identifying as Poky.
TARGET_VENDOR = "-secluso"

SDK_VENDOR = "-seclusosdk"
SDK_VERSION = "${@d.getVar('DISTRO_VERSION').replace('snapshot-${METADATA_REVISION}', 'snapshot')}"
SDK_VERSION[vardepvalue] = "${SDK_VERSION}"
SDK_NAME = "${DISTRO}-${TCLIBC}-${SDKMACHINE}-${IMAGE_BASENAME}-${TUNE_PKGARCH}-${MACHINE}"
SDKPATHINSTALL = "/opt/${DISTRO}/${SDK_VERSION}"

LOCALCONF_VERSION = "2"

# poky.conf sets POKY_DEFAULT_DISTRO_FEATURES = "opengl ptest multiarch wayland vulkan" and adds it to DISTRO_FEATURES.
# None of those apply to a headless camera image (what we're working on), so we omit them entirely.
# Anything we actually need on top of DISTRO_FEATURES_DEFAULT (from OE-Core) is appended below.
DISTRO_FEATURES ?= "${DISTRO_FEATURES_DEFAULT}"

# Secluso uses systemd.
# TODO: systemd adds a lot of time to boot vs sysvinit. Can we improve on this?
INIT_MANAGER ?= "systemd"
DISTRO_FEATURES:append = " systemd usrmerge"
DISTRO_FEATURES_BACKFILL_CONSIDERED += "sysvinit"

# Wi-Fi is of course a hard requirement for our camera
DISTRO_FEATURES:append = " wifi"

# Mirror poky's extra runtime dependencies.
# packagegroup-core-boot  makes the rootfs bootable
# more information: https://github.com/openembedded/openembedded-core/blob/master/meta/recipes-core/packagegroups/packagegroup-core-boot.bb
DISTRO_EXTRA_RDEPENDS += "packagegroup-core-boot"
# af-packet is needed for things like tcpdump / DHCP clients on some configurations.
# information on the dependency: https://github.com/snort3/libdaq/blob/master/modules/afpacket/README.afpacket.md
DISTRO_EXTRA_RRECOMMENDS += "kernel-module-af-packet"

PREFERRED_VERSION_linux-yocto ?= "6.16%"
PREFERRED_VERSION_linux-yocto-rt ?= "6.16%"

# TODO: Could be worth swapping to package_ipk (would shrink intermediate build metadata at no runtime cost)
# See some discussion on this at https://docs.yoctoproject.org/ref-manual/classes.html#package
PACKAGE_CLASSES ?= "package_rpm"

# Removed a bunch from the list in Poky's tested ones, as we are early stage and it isn't beneficial to test development on tons of machines.
# To test reproducibility against our provided image, an Ubuntu VPS can be easily provisioned.
SANITY_TESTED_DISTROS ?= " \
            ubuntu-22.04 \n \
            ubuntu-24.04 \n \
            ubuntu-25.04 \n \
            ubuntu-25.10 \n \
            debian-11 \n \
            debian-12 \n \
            debian-13 \n \
            "

# Includes pulled in by poky.conf.
require conf/distro/include/no-static-libs.inc
require conf/distro/include/yocto-uninative.inc

# These security flags are injected into userspace packages (libcamera, NetworkManger, etc)
# They do not affect the kernel. Therefore, we need kernel hardening in addition to this.
# TODO: Kernel hardening work. E.g. FORTIFY_SOURCE, STRICT_KERNEL_RWX...
require conf/distro/include/security_flags.inc
require conf/distro/include/yocto-space-optimize.inc

# meta-poky's gcsections.inc (function/data section GC for smaller binaries).
# Copied into our repository so that we don't need to depend on Poky for it
require conf/distro/include/gcsections.inc

INHERIT += "uninative"

BB_SIGNATURE_HANDLER ?= "OEEquivHash"
BB_HASHSERVE ??= "auto"

# Needed for SPDX license manifests covering the kernel.
KERNEL_EXTRA_FEATURES:append = " features/debug/debug-kernel.scc"
```

## meta-secluso-os/conf/layer.conf
```bitbake
# SPDX-License-Identifier: GPL-3.0-only
# Copyright (C) 2026 Secluso, Inc.
# Additional terms apply; see the NOTICE file in the repository root.

# Default layer.conf provided by bitbake-layers

# We have a conf and classes directory, add to BBPATH
BBPATH .= ":${LAYERDIR}"

# We have recipes-* directories, add to BBFILES
BBFILES += "${LAYERDIR}/recipes-*/*/*.bb \
            ${LAYERDIR}/recipes-*/*/*.bbappend"

BBFILE_COLLECTIONS += "secluso-os"
BBFILE_PATTERN_secluso-os = "^${LAYERDIR}/"
BBFILE_PRIORITY_secluso-os = "6"

LAYERDEPENDS_secluso-os = "core"
LAYERSERIES_COMPAT_secluso-os = "whinlatter"
```
